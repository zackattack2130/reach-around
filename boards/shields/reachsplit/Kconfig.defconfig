## boards/shields/reachsplit/Kconfig.defconfig
```kconfig
if SHIELD_REACHSPLIT_LEFT

# Name must be less than 16 characters long!
config ZMK_KEYBOARD_NAME
    default "reachsplit"

config ZMK_SPLIT_ROLE_CENTRAL
    default y

endif

if SHIELD_REACHSPLIT_LEFT || SHIELD_REACHSPLIT_RIGHT

config ZMK_SPLIT
    default y

endif
```

## boards/shields/reachsplit/Kconfig.shield
```kconfig
config SHIELD_REACHSPLIT_LEFT
    def_bool $(shields_list_contains,reachsplit_left)

config SHIELD_REACHSPLIT_RIGHT
    def_bool $(shields_list_contains,reachsplit_right)
```
